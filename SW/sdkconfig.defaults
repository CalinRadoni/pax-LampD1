## SW/sdkconfig.defaults
```kconfig
#
# For a module with 4MB flash size
#
CONFIG_ESPTOOLPY_FLASHSIZE_4MB=y
CONFIG_ESPTOOLPY_FLASHSIZE_DETECT=y

#
# Custom partitions
#
CONFIG_PARTITION_TABLE_SINGLE_APP=n
CONFIG_PARTITION_TABLE_TWO_OTA=n
CONFIG_PARTITION_TABLE_CUSTOM=y
CONFIG_PARTITION_TABLE_CUSTOM_FILENAME="partitions.csv"
CONFIG_PARTITION_TABLE_FILENAME="partitions.csv"

#
# Stack checks
#
CONFIG_COMPILER_STACK_CHECK_MODE_NORM=y
CONFIG_COMPILER_STACK_CHECK=y

#
# NVS and PHY and WiFi
#
CONFIG_ESP32_PHY_CALIBRATION_AND_DATA_STORAGE=n
CONFIG_ESP32_PHY_INIT_DATA_IN_PARTITION=n
CONFIG_ESP32_WIFI_NVS_ENABLED=n

#
# Network
#
CONFIG_ESP_NETIF_TCPIP_ADAPTER_COMPATIBLE_LAYER=n

#
# FreeRTOS
#
CONFIG_FREERTOS_HZ=100

#
# FreeRTOS extended task info
#
CONFIG_FREERTOS_USE_TRACE_FACILITY=y
CONFIG_FREERTOS_GENERATE_RUN_TIME_STATS=y
CONFIG_FREERTOS_VTASKLIST_INCLUDE_COREID=y

#
# HTTP Server configuration
#
CONFIG_HTTPD_MAX_URI_LEN=1024
```
